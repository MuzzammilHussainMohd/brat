## CMakeLists.txt
```
#
# SmartLock-7A21 - deliberately vulnerable BLE demo target
#
cmake_minimum_required(VERSION 3.20.0)

find_package(Zephyr REQUIRED HINTS $ENV{ZEPHYR_BASE})
project(demo_target)

target_sources(app PRIVATE
  src/main.c
  src/frame.c
)
target_include_directories(app PRIVATE src)
```

## prj.conf
```kconfig
# GlucoSense-OPEN - demo target configuration (insecure v1 build)
#
# Note what is deliberately ABSENT: no CONFIG_BT_SMP, no bonding, no
# encryption requirement on any characteristic. That is the point of the
# target - every weakness BRAT reports is a real property of this build.

CONFIG_NCS_SAMPLES_DEFAULTS=y

# --- Bluetooth ------------------------------------------------------------
CONFIG_BT=y
CONFIG_BT_PERIPHERAL=y
CONFIG_BT_DEVICE_NAME="GlucoSense-OPEN"
CONFIG_BT_DEVICE_APPEARANCE=0

# Larger ATT MTU so a whole frame fits in one write. The default of 23 caps
# payloads at 20 bytes, which would force the client to fragment and make
# the protocol harder to read in a session log.
CONFIG_BT_L2CAP_TX_MTU=247
CONFIG_BT_BUF_ACL_RX_SIZE=251
CONFIG_BT_BUF_ACL_TX_SIZE=251
CONFIG_BT_CTLR_DATA_LENGTH_MAX=251
CONFIG_BT_ATT_PREPARE_COUNT=2

# --- Board support --------------------------------------------------------
CONFIG_DK_LIBRARY=y
CONFIG_GPIO=y

# --- Console / logging ----------------------------------------------------
# Serial console is how the audience sees the device's internal reaction to
# each frame while the attack is running.
#
# Deliberately NOT LOG_MODE_IMMEDIATE: that formats and writes each message
# synchronously on the calling thread's stack, and the Bluetooth callbacks
# here log from threads with stacks nowhere near large enough for it. It
# overflows within ~50ms of boot and puts the board in a reset loop, which
# presents as a device that advertises but never completes a connection.
# Deferred logging hands the work to a dedicated log thread instead.
CONFIG_SERIAL=y
CONFIG_CONSOLE=y
CONFIG_UART_CONSOLE=y
CONFIG_LOG=y
CONFIG_LOG_BUFFER_SIZE=4096
CONFIG_BT_DEVICE_NAME_DYNAMIC=n

# Thread names and stack info make the next fault report name the culprit
# rather than saying "unknown".
CONFIG_THREAD_NAME=y
CONFIG_THREAD_STACK_INFO=y

CONFIG_HEAP_MEM_POOL_SIZE=4096
CONFIG_MAIN_STACK_SIZE=4096
CONFIG_SYSTEM_WORKQUEUE_STACK_SIZE=4096
CONFIG_BT_RX_STACK_SIZE=4096

# Needed for the DFU-decoy reboot.
CONFIG_REBOOT=y
```

## prj_secure.conf
```kconfig
# GlucoSense-SECURE - demo target configuration (secure v2 build)
#
# This is the SECURE version with SMP pairing, bonding, and MITM protection.
# Use this to demonstrate the contrast with the insecure v1 build.

CONFIG_NCS_SAMPLES_DEFAULTS=y

# --- Bluetooth ------------------------------------------------------------
CONFIG_BT=y
CONFIG_BT_PERIPHERAL=y
CONFIG_BT_DEVICE_NAME="GlucoSense-SECURE"
CONFIG_BT_DEVICE_APPEARANCE=0

# Larger ATT MTU so a whole frame fits in one write. The default of 23 caps
# payloads at 20 bytes, which would force the client to fragment and make
# the protocol harder to read in a session log.
CONFIG_BT_L2CAP_TX_MTU=247
CONFIG_BT_BUF_ACL_RX_SIZE=251
CONFIG_BT_BUF_ACL_TX_SIZE=251
CONFIG_BT_CTLR_DATA_LENGTH_MAX=251
CONFIG_BT_ATT_PREPARE_COUNT=2

# --- Security (SMP) -------------------------------------------------------
# Enable Security Manager Protocol for pairing and encryption
CONFIG_BT_SMP=y
CONFIG_BT_BONDABLE=y
CONFIG_BT_BONDING_REQUIRED=y
CONFIG_BT_SMP_APP_PAIRING_ACCEPT=y

# Passkey/MITM protection - requires numeric passkey entry
CONFIG_BT_SMP_ENFORCE_MITM=y
CONFIG_BT_FIXED_PASSKEY=y

# --- Bond storage (persistent pairing) ------------------------------------
CONFIG_BT_SETTINGS=y
CONFIG_FLASH=y
CONFIG_FLASH_MAP=y
CONFIG_NVS=y
CONFIG_SETTINGS=y

# --- Board support --------------------------------------------------------
CONFIG_DK_LIBRARY=y
CONFIG_GPIO=y

# --- Console / logging ----------------------------------------------------
# Serial console is how the audience sees the device's internal reaction to
# each frame while the attack is running.
#
# Deliberately NOT LOG_MODE_IMMEDIATE: that formats and writes each message
# synchronously on the calling thread's stack, and the Bluetooth callbacks
# here log from threads with stacks nowhere near large enough for it. It
# overflows within ~50ms of boot and puts the board in a reset loop, which
# presents as a device that advertises but never completes a connection.
# Deferred logging hands the work to a dedicated log thread instead.
CONFIG_SERIAL=y
CONFIG_CONSOLE=y
CONFIG_UART_CONSOLE=y
CONFIG_LOG=y
CONFIG_LOG_BUFFER_SIZE=4096
CONFIG_BT_DEVICE_NAME_DYNAMIC=n

# Thread names and stack info make the next fault report name the culprit
# rather than saying "unknown".
CONFIG_THREAD_NAME=y
CONFIG_THREAD_STACK_INFO=y

CONFIG_HEAP_MEM_POOL_SIZE=4096
CONFIG_MAIN_STACK_SIZE=4096
CONFIG_SYSTEM_WORKQUEUE_STACK_SIZE=4096
CONFIG_BT_RX_STACK_SIZE=4096

# Needed for the DFU-decoy reboot.
CONFIG_REBOOT=y
```

## src/frame.c
```c
/*
 * Frame codec for GlucoSense-7A21. See frame.h for the wire layout.
 */

#include <string.h>

#include "frame.h"

uint16_t frame_crc16(const uint8_t *data, size_t len)
{
	uint16_t crc = 0xFFFF;

	for (size_t i = 0; i < len; i++) {
		crc ^= data[i];
		for (int bit = 0; bit < 8; bit++) {
			if (crc & 1U) {
				crc = (crc >> 1) ^ 0xA001;
			} else {
				crc >>= 1;
			}
		}
	}

	return crc;
}

bool frame_parse(const uint8_t *buf, size_t len, struct frame *out)
{
	if (len < FRAME_OVERHEAD) {
		return false;
	}

	if (buf[0] != FRAME_START || buf[1] != FRAME_RESERVED ||
	    buf[3] != FRAME_DST || buf[4] != FRAME_SRC) {
		return false;
	}

	uint16_t payload_len = ((uint16_t)buf[6] << 8) | buf[7];

	if (payload_len > FRAME_MAX_PAYLOAD) {
		return false;
	}

	/* The frame must be exactly this long - no trailing bytes. A write
	 * carrying more than one frame is rejected rather than partially
	 * accepted, so a malformed batch cannot smuggle a second command.
	 */
	if (len != (size_t)FRAME_OVERHEAD + payload_len) {
		return false;
	}

	if (buf[len - 1] != FRAME_END) {
		return false;
	}

	size_t crc_offset = 8 + payload_len;
	uint16_t got = ((uint16_t)buf[crc_offset] << 8) | buf[crc_offset + 1];
	uint16_t want = frame_crc16(buf, crc_offset);

	if (got != want) {
		return false;
	}

	out->direction = buf[2];
	out->cmd = buf[5];
	out->length = payload_len;
	if (payload_len) {
		memcpy(out->payload, &buf[8], payload_len);
	}

	return true;
}

size_t frame_build(uint8_t *buf, size_t buf_len, uint8_t direction, uint8_t cmd,
		   const uint8_t *payload, uint16_t payload_len)
{
	if (payload_len > FRAME_MAX_PAYLOAD) {
		return 0;
	}

	size_t total = (size_t)FRAME_OVERHEAD + payload_len;

	if (buf_len < total) {
		return 0;
	}

	buf[0] = FRAME_START;
	buf[1] = FRAME_RESERVED;
	buf[2] = direction;
	buf[3] = FRAME_DST;
	buf[4] = FRAME_SRC;
	buf[5] = cmd;
	buf[6] = (uint8_t)(payload_len >> 8);
	buf[7] = (uint8_t)(payload_len & 0xFF);

	if (payload_len && payload != NULL) {
		memcpy(&buf[8], payload, payload_len);
	}

	size_t crc_offset = 8 + payload_len;
	uint16_t crc = frame_crc16(buf, crc_offset);

	buf[crc_offset] = (uint8_t)(crc >> 8);
	buf[crc_offset + 1] = (uint8_t)(crc & 0xFF);
	buf[crc_offset + 2] = FRAME_END;

	return total;
}
```

## src/frame.h
```c
/*
 * GlucoSense-7A21 wire protocol.
 *
 * Fixed-layout framing carried over the Nordic UART Service:
 *
 *   7E 00 <dir> 10 20 <cmd> <len:u16be> <payload...> <crc16:be> EF
 *   |  |   |    |  |    |      |            |            |      |
 *   |  |   |    |  |    |      |            |            |      end marker
 *   |  |   |    |  |    |      |            |            CRC-16/MODBUS, big-endian
 *   |  |   |    |  |    |      |            payload, `len` bytes
 *   |  |   |    |  |    |      payload length, 16-bit big-endian
 *   |  |   |    |  |    command byte
 *   |  |   |    |  source address (constant)
 *   |  |   |    destination address (constant)
 *   |  |   direction: 0 = from client, 1 = ack, 2 = push
 *   |  reserved
 *   start marker
 *
 * The CRC covers every byte from `start` through the end of `payload` -
 * that is, everything before the CRC field itself. It does NOT cover the
 * end marker.
 *
 * The length field is a full 16 bits even though no command here uses a
 * payload longer than 64 bytes, so its high byte reads as a constant 0x00
 * in every capture. That is deliberate: it is exactly the kind of detail a
 * frame-inference pass has to get right, and misreading it as padding
 * produces a decoder that works until the first long response.
 */

#ifndef FRAME_H_
#define FRAME_H_

#include <zephyr/kernel.h>
#include <stdbool.h>
#include <stdint.h>

#define FRAME_START     0x7E
#define FRAME_RESERVED  0x00
#define FRAME_DST       0x10
#define FRAME_SRC       0x20
#define FRAME_END       0xEF

/* Byte count of everything that is not payload. */
#define FRAME_OVERHEAD  11
#define FRAME_MAX_PAYLOAD 64
#define FRAME_MAX_LEN   (FRAME_OVERHEAD + FRAME_MAX_PAYLOAD)

/* Direction field values. */
#define DIR_REQUEST     0x00
#define DIR_ACK         0x01
#define DIR_PUSH        0x02

/* Commands. */
#define CMD_PING        0x01
#define CMD_AUTH        0x10
#define CMD_ALARM_SET   0x20
#define CMD_STATUS      0x30
#define CMD_TELEMETRY   0x40

struct frame {
	uint8_t  direction;
	uint8_t  cmd;
	uint16_t length;
	uint8_t  payload[FRAME_MAX_PAYLOAD];
};

/* CRC-16/MODBUS: poly 0x8005 reflected (0xA001), init 0xFFFF, no final XOR. */
uint16_t frame_crc16(const uint8_t *data, size_t len);

/*
 * Parse one frame from `buf`. Returns true only if the markers, length and
 * CRC all check out. `out` is untouched on failure.
 */
bool frame_parse(const uint8_t *buf, size_t len, struct frame *out);

/*
 * Serialise a frame. Returns the number of bytes written to `buf`, or 0 if
 * `payload_len` exceeds FRAME_MAX_PAYLOAD or the buffer is too small.
 */
size_t frame_build(uint8_t *buf, size_t buf_len, uint8_t direction, uint8_t cmd,
		   const uint8_t *payload, uint16_t payload_len);

#endif /* FRAME_H_ */
```
